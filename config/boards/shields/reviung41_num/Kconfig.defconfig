## config/boards/shields/reviung41_num/Kconfig.defconfig
```kconfig
# Copyright (c) 2020 The ZMK Contributors
# SPDX-License-Identifier: MIT

if SHIELD_REVIUNG41_NUM

config ZMK_KEYBOARD_NAME
	default "Luke's Spacedeck 🚀"

endif
```

## config/boards/shields/wombat/Kconfig.shield
```kconfig
# Copyright (c) 2020 The ZMK Contributors
# SPDX-License-Identifier: MIT

config SHIELD_REVIUNG41_NUM
	def_bool $(shields_list_contains,reviung41_num)
```
